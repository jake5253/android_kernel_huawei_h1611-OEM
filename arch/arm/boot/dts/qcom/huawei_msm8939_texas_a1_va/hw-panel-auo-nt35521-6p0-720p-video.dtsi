/* Copyright (c) 2013, The Linux Foundation. All rights reserved.
 *
 * This program is free software; you can redistribute it and/or modify
 * it under the terms of the GNU General Public License version 2 and
 * only version 2 as published by the Free Software Foundation.
 *
 * This program is distributed in the hope that it will be useful,
 * but WITHOUT ANY WARRANTY; without even the implied warranty of
 * MERCHANTABILITY or FITNESS FOR A PARTICULAR PURPOSE.  See the
 * GNU General Public License for more details.
 */

/*---------------------------------------------------------------------------
 * This file is autogenerated file using gcdb parser. Please do not edit it.
 * Update input XML file to add a new entry or update variable in this file
 * VERSION = "1.0"
 *---------------------------------------------------------------------------*/
&mdss_mdp {
	dsi_auo_nt35521_6p0_720p_video: qcom,mdss_dsi_auo_nt35521_6p0_720p_video {
		qcom,mdss-dsi-panel-name = "AUO_NT35521_6P0_720P_VIDEO";
		qcom,cont-splash-enabled;
		qcom,mdss-dsi-panel-controller = <&mdss_dsi0>;
		qcom,mdss-dsi-panel-type = "dsi_video_mode";
		qcom,mdss-dsi-panel-destination = "display_1";
		qcom,mdss-dsi-panel-clockrate = <514200000>;
		qcom,mdss-dsi-panel-framerate = <60>;
		qcom,mdss-dsi-virtual-channel-id = <0>;
		qcom,mdss-dsi-stream = <0>;
		qcom,mdss-dsi-panel-width = <720>;
		qcom,mdss-dsi-panel-height = <1280>;
		qcom,mdss-dsi-h-front-porch = <154>;
		qcom,mdss-dsi-h-back-porch = <216>;
		qcom,mdss-dsi-h-pulse-width = <2>;
		qcom,mdss-dsi-h-sync-skew = <0>;
		qcom,mdss-dsi-v-back-porch = <12>;
		qcom,mdss-dsi-v-front-porch = <14>;
		qcom,mdss-dsi-v-pulse-width = <2>;
		qcom,mdss-dsi-h-left-border = <0>;
		qcom,mdss-dsi-h-right-border = <0>;
		qcom,mdss-dsi-v-top-border = <0>;
		qcom,mdss-dsi-v-bottom-border = <0>;
		qcom,mdss-dsi-bpp = <24>;
		qcom,mdss-dsi-underflow-color = <0x00>;
		qcom,mdss-dsi-border-color = <0>;
		qcom,mdss-dsi-color-order = "rgb_swap_rgb";
		qcom,mdss-dsi-on-command = [39 01 00 00 00 00 06 F0 55 AA 52 08 00
			39 01 00 00 00 00 03 B1 60 21
			15 01 00 00 00 00 02 6F 02
			15 01 00 00 00 00 02 B2 02
			39 01 00 00 00 00 03 D9 02 09
			15 01 00 00 00 00 02 B6 01
			39 01 00 00 00 00 05 B8 01 02 08 02
			15 01 00 00 00 00 02 C8 83
			39 01 00 00 00 00 06 F0 55 AA 52 08 01
			39 01 00 00 00 00 03 B3 1E 1E
			39 01 00 00 00 00 03 B4 19 19
			39 01 00 00 00 00 03 B9 35 35
			39 01 00 00 00 00 03 BA 25 25
			39 01 00 00 00 00 03 BC 70 00
			39 01 00 00 00 00 03 BD 70 00
			15 01 00 00 00 00 02 C0 0C
			15 01 00 00 00 00 02 CA 00
			39 01 00 00 00 00 06 F0 55 AA 52 08 02
			15 01 00 00 00 00 02 EE 11
			39 01 00 00 00 00 11 B0 00 17 00 40 00 5D 00 76 00 8B 00 AF 00 CD 00 FE
			39 01 00 00 00 00 11 B1 01 27 01 67 01 9A 01 EB 02 2A 02 2C 02 65 02 A2
			39 01 00 00 00 00 11 B2 02 C8 02 F9 03 19 03 44 03 5E 03 7E 03 92 03 AA
			39 01 00 00 00 00 05 B3 03 C2 03 C6
			39 01 00 00 00 00 11 B4 00 17 00 40 00 5C 00 74 00 89 00 AD 00 CB 00 FC
			39 01 00 00 00 00 11 B5 01 24 01 65 01 99 01 EB 02 2A 02 2C 02 65 02 A2
			39 01 00 00 00 00 11 B6 02 C7 02 FB 03 1B 03 44 03 5E 03 7F 03 93 03 AC
			39 01 00 00 00 00 05 B7 03 C3 03 C6
			39 01 00 00 00 00 11 B8 00 17 00 3F 00 5A 00 72 00 87 00 AB 00 C9 00 FB
			39 01 00 00 00 00 11 B9 01 24 01 66 01 9A 01 ED 02 2C 02 2E 02 66 02 A2 
			39 01 00 00 00 00 11 BA 02 C7 02 FC 03 1A 03 44 03 5E 03 7E 03 92 03 AB 
			39 01 00 00 00 00 05 BB 03 C2 03 C6
			39 01 00 00 00 00 06 F0 55 AA 52 08 03
			39 01 00 00 00 00 03 B0 00 00
			39 01 00 00 00 00 03 B1 00 00
			39 01 00 00 00 00 06 B2 04 00 40 01 58
			39 01 00 00 00 00 06 B3 04 00 40 01 58
			39 01 00 00 00 00 06 B6 04 00 46 01 68
			39 01 00 00 00 00 06 B7 04 00 46 01 68
			39 01 00 00 00 00 06 BA 44 00 46 01 55
			39 01 00 00 00 00 06 BB 44 00 46 01 55
			39 01 00 00 00 00 06 BC 53 00 15 00 48
			39 01 00 00 00 00 06 BD 53 00 15 00 48
			15 01 00 00 00 00 02 C4 60
			15 01 00 00 00 00 02 C5 40
			39 01 00 00 00 00 06 F0 55 AA 52 08 05
			39 01 00 00 00 00 03 B0 17 06
			39 01 00 00 00 00 03 B1 17 06
			39 01 00 00 00 00 03 B2 17 06
			39 01 00 00 00 00 03 B3 17 06
			39 01 00 00 00 00 03 B4 17 06
			39 01 00 00 00 00 03 B5 17 06
			39 01 00 00 00 00 03 B6 17 06
			39 01 00 00 00 00 03 B7 17 06
			15 01 00 00 00 00 02 B8 00
			15 01 00 00 00 00 02 B9 00
			15 01 00 00 00 00 02 BA 00
			15 01 00 00 00 00 02 BB 00
			15 01 00 00 00 00 02 BC 00
			39 01 00 00 00 00 06 BD 0F 03 03 00 03
			15 01 00 00 00 00 02 C0 07
			15 01 00 00 00 00 02 C1 05
			15 01 00 00 00 00 02 C4 82
			15 01 00 00 00 00 02 C5 80
			39 01 00 00 00 00 03 C8 03 20
			39 01 00 00 00 00 03 C9 01 21
			39 01 00 00 00 00 03 CA 03 20
			39 01 00 00 00 00 03 CB 07 20
			39 01 00 00 00 00 0C D1 03 05 00 05 00 00 00 00 00 00 00
			39 01 00 00 00 00 0C D2 03 05 00 03 00 00 00 00 00 00 00
			39 01 00 00 00 00 0C D3 03 05 04 05 00 00 00 00 00 00 00
			39 01 00 00 00 00 0C D4 03 05 04 03 00 00 00 00 00 00 00
			15 01 00 00 00 00 02 E5 06
			15 01 00 00 00 00 02 E6 06
			15 01 00 00 00 00 02 E7 06
			15 01 00 00 00 00 02 E8 06
			15 01 00 00 00 00 02 E9 0A
			15 01 00 00 00 00 02 EA 06
			15 01 00 00 00 00 02 EB 06
			15 01 00 00 00 00 02 EC 06
			15 01 00 00 00 00 02 ED 30
			39 01 00 00 00 00 06 F0 55 AA 52 08 06
			39 01 00 00 00 00 03 B0 2E 2E
			39 01 00 00 00 00 03 B1 2E 2E
			39 01 00 00 00 00 03 B2 2E 2E
			39 01 00 00 00 00 03 B3 2E 09
			39 01 00 00 00 00 03 B4 0B 11
			39 01 00 00 00 00 03 B5 17 19
			39 01 00 00 00 00 03 B6 1D 23
			39 01 00 00 00 00 03 B7 1F 25
			39 01 00 00 00 00 03 B8 01 03
			39 01 00 00 00 00 03 B9 2E 2E
			39 01 00 00 00 00 03 BA 2E 2E
			39 01 00 00 00 00 03 BB 02 00
			39 01 00 00 00 00 03 BC 24 1E
			39 01 00 00 00 00 03 BD 22 1C
			39 01 00 00 00 00 03 BE 18 16
			39 01 00 00 00 00 03 BF 10 0A
			39 01 00 00 00 00 03 C0 08 2E
			39 01 00 00 00 00 03 C1 2E 2E
			39 01 00 00 00 00 03 C2 2E 2E
			39 01 00 00 00 00 03 C3 2E 2E
			39 01 00 00 00 00 03 C4 2E 2E
			39 01 00 00 00 00 03 C5 2E 2E
			39 01 00 00 00 00 03 C6 2E 2E
			39 01 00 00 00 00 03 C7 2E 02
			39 01 00 00 00 00 03 C8 00 18
			39 01 00 00 00 00 03 C9 12 10
			39 01 00 00 00 00 03 CA 1E 24
			39 01 00 00 00 00 03 CB 1C 22
			39 01 00 00 00 00 03 CC 0A 08
			39 01 00 00 00 00 03 CD 2E 2E
			39 01 00 00 00 00 03 CE 2E 2E
			39 01 00 00 00 00 03 CF 09 0B
			39 01 00 00 00 00 03 D0 23 1D
			39 01 00 00 00 00 03 D1 25 1F
			39 01 00 00 00 00 03 D2 11 13
			39 01 00 00 00 00 03 D3 19 01
			39 01 00 00 00 00 03 D4 03 2E
			39 01 00 00 00 00 03 D5 2E 2E
			39 01 00 00 00 00 03 D6 2E 2E
			39 01 00 00 00 00 03 D7 2E 2E
			39 01 00 00 00 00 06 D8 00 00 00 00 00
			39 01 00 00 00 00 06 D9 00 00 00 00 00
			39 01 00 00 00 00 03 E5 13 12
			39 01 00 00 00 00 03 E6 16 17
			15 01 00 00 00 00 02 E7 00
			15 01 00 00 00 00 02 51 00
			15 01 00 00 00 00 02 53 24
			15 01 00 00 00 00 02 55 01
			15 01 00 00 00 00 02 5E 28
			05 01 00 00 78 00 02 11 00
			05 01 00 00 14 00 02 29 00];
		qcom,mdss-dsi-off-command = [05 01 00 00 14 00 02 28 00
					05 01 00 00 78 00 02 10 00];
		qcom,mdss-dsi-on-command-state = "dsi_lp_mode";
		qcom,mdss-dsi-off-command-state = "dsi_hs_mode";
		qcom,mdss-dsi-h-sync-pulse = <1>;
		qcom,mdss-dsi-traffic-mode = "burst_mode";
		qcom,mdss-dsi-lane-map = "lane_map_0123";
		qcom,mdss-dsi-bllp-eof-power-mode;
		qcom,mdss-dsi-bllp-power-mode;
		qcom,mdss-dsi-lane-0-state;
		qcom,mdss-dsi-lane-1-state;
		qcom,mdss-dsi-lane-2-state;
		qcom,mdss-dsi-lane-3-state;
		qcom,mdss-dsi-panel-timings = [96 20 14 00 46 4A 1A 24 1E 03 04 00];
		qcom,mdss-dsi-t-clk-post = <0x04>;
		qcom,mdss-dsi-t-clk-pre = <0x1B>;
		qcom,mdss-dsi-bl-min-level = <2>;
		qcom,mdss-dsi-bl-max-level = <255>;
		qcom,mdss-dsi-dma-trigger = "trigger_sw";
		qcom,mdss-dsi-mdp-trigger = "none";
		qcom,mdss-dsi-bl-pmic-control-type = "bl_ctrl_dcs";
		qcom,panel-cabc-ui-cmds = [15 01 00 00 00 00 02 55 01
					15 01 00 00 00 00 02 53 24];
		qcom,panel-cabc-video-cmds = [15 01 00 00 00 00 02 55 03
					 15 01 00 00 00 00 02 53 2C];
		qcom,cabc-ui-cmds-dsi-state = "dsi_lp_mode";
		qcom,cabc-video-cmds-dsi-state = "dsi_lp_mode";
		qcom,panel-dot-inversion-mode-cmds = [29 01 00 00 00 00 06 F0 55 AA 52 08 00
				29 01 00 00 00 00 03 BC 01 01];
		qcom,panel-column-inversion-mode-cmds = [29 01 00 00 00 00 06 F0 55 AA 52 08 00
				29 01 00 00 00 00 03 BC 00 00];
		qcom,dot-inversion-cmds-dsi-state = "dsi_lp_mode";
		qcom,column-inversion-cmds-dsi-state = "dsi_lp_mode";
		qcom,mdss-dsi-lp11-init;
		qcom,mdss-pan-physical-width-dimension = <75>;
		qcom,mdss-pan-physical-height-dimension = <133>;
			qcom,mdss-dsi-reset-sequence = <1 5>, <0 5>, <1 25>;

	};
};
