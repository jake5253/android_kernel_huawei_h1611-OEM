 / {
        huawei_bt_info {
                  compatible = "huawei,hw_bt_info";
                  status = "ok";
                  bt,fw_ver = "QCOM_WCN3680B_2.0.1";
                  bt,chiptype = "BT_FM_QUALCOMM_WCN3680B";
        };
};
