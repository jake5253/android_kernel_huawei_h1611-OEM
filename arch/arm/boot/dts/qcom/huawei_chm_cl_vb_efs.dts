/* Copyright (c) 2014, The Linux Foundation. All rights reserved.
 *
 * This program is free software; you can redistribute it and/or modify
 * it under the terms of the GNU General Public License version 2 and
 * only version 2 as published by the Free Software Foundation.
 *
 * This program is distributed in the hope that it will be useful,
 * but WITHOUT ANY WARRANTY; without even the implied warranty of
 * MERCHANTABILITY or FITNESS FOR A PARTICULAR PURPOSE.  See the
 * GNU General Public License for more details.
 */
/dts-v1/;
#include "msm8939.dtsi"
#include "msm8939-qrd.dtsi"
#include "huawei_msm8939_chm_cl_vb/huawei.dtsi"
/ {
	model = "Qualcomm MSM 8939 HUAWEI CHM-CL";
	compatible = "qcom,msm8939-qrd", "qcom,msm8939", "qcom,qrd";
	qcom,board-id = <8064 0x0> , <8064 0x4>;/*1G*/
	huawei,modem_id = <0xFFFC0100 0x0>;
};

&pm8916_bms {
	status = "ok";
};

&soc {
	qcom,rmtfs_sharedmem@8e580000 {
		compatible = "qcom,sharedmem-uio";
		reg = <0x86690000 0x150000>;
		reg-names = "rmtfs";
		qcom,client-id = <0x00000001>;
	};
};